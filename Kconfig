## Kconfig
```kconfig
menu "Dephy Web"

config DEPHY_WEB
	bool "Enable Dephy web profile metadata"
	default n
	help
	  Enable generic Dephy web profile metadata.

endmenu
```

## zephyr/Kconfig
```kconfig
menuconfig DEPHY_WEB
	bool "Dephy web profile metadata"
	default n
	help
	  Enable reusable Dephy web profile metadata.
```
